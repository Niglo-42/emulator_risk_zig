ENTRY(_start)

SECTIONS
{
    . = 0x80000000;

    _stack_top = 0x80000;

    .text : {
        *(.text.start)
        *(.text*)
    }

    .rodata : {
        *(.rodata*)
    }

    .data : {
        *(.data*)
    }

    .bss : {
        *(.bss*)
        *(COMMON)
    }
}
